## build/conf/bblayers.conf
```bitbake
# POKY_BBLAYERS_CONF_VERSION is increased each time build/conf/bblayers.conf
# changes incompatibly
POKY_BBLAYERS_CONF_VERSION = "2"

BBPATH = "${TOPDIR}"
BBFILES ?= ""

BBLAYERS ?= " \
  /home/totar/rpi3/src/poky/meta \
  /home/totar/rpi3/src/poky/meta-poky \
  /home/totar/rpi3/src/poky/meta-yocto-bsp \
  /home/totar/rpi3/src/meta-openembedded/meta-oe \
  /home/totar/rpi3/src/meta-openembedded/meta-filesystems \
  /home/totar/rpi3/src/meta-openembedded/meta-python \
  /home/totar/rpi3/src/meta-openembedded/meta-networking \
  /home/totar/rpi3/src/meta-raspberrypi \
  /home/totar/rpi3/src/meta-virtualization \
  "
```
